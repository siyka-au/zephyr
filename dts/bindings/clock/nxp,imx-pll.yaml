## dts/bindings/clock/nxp,imx-pll.yaml
```yaml
# Copyright (c) 2017, NXP
# SPDX-License-Identifier: Apache-2.0

description: i.MX PLL

compatible: "nxp,imx-pll"

include: base.yaml

properties:
    reg:
      required: true

    label:
      required: true

    enable:
      type: boolean
      required: true

    bypass-clk-src:
      type: int
      enum:
        - 0
        - 1
      required: true

    divider:
      type: int
    
    numerator:
      type: int

    denominator:
      type: int

    post-divider:
      type: int
```

## dts/bindings/display/fsl,imx6sx-lcdif.yaml
```yaml
# Copyright (c) 2019, NXP
# SPDX-License-Identifier: Apache-2.0

description: NXP i.MX eLCDIF (Enhanced LCD Interface) controller

compatible: "fsl,imx6sx-lcdif"

include: base.yaml

properties:
    reg:
      required: true

    interrupts:
      required: true

    clk-source:
      type: int
      enum:
        - 0
        - 1
        - 2
        - 3
        - 4
        - 5
      required: true

    clk-pre-divider:
      type: int
      required: true
      enum:
        - 0
        - 1
        - 2
        - 3
        - 4
        - 5
        - 6
        - 7

    clk-post-divider:
      type: int
      enum:
        - 0
        - 1
        - 2
        - 3
        - 4
        - 5
        - 6
        - 7
      required: true

    label:
      required: true
```

## dts/bindings/display/rocktech,rk043fn02h-ct.yaml
```yaml
# Copyright (c) 2019, NXP
# SPDX-License-Identifier: Apache-2.0

description: Rocktech LCD module with LED backlight and capacitive touch panel

compatible: "rocktech,rk043fn02h-ct"

include: base.yaml

properties:
    bits-per-pixel:
      type: int
      required: true

    bus-width:
      type: int
      enum:
        - 8
        - 16
        - 24
        - 32
      required: true

    clock-frequency:
      type: int
      required: false

    h-active:
      type: int
      required: true

    v-active:
      type: int
      required: true
      
    h-sync:
      type: int
      required: true
      
    h-front-porch:
      type: int
      required: true
      
    h-back-porch:
      type: int
      required: true
      
    v-sync:
      type: int
      required: true
      
    v-front-porch:
      type: int
      required: true
      
    v-back-porch:
      type: int
      required: true
      
    h-sync-active-high:
      type: boolean
      required: false

    h-sync-active-low:
      type: boolean
      required: false
      
    v-sync-active-high:
      type: boolean
      required: false

    v-sync-active-low:
      type: boolean
      required: false
      
    de-active-high:
      type: boolean
      required: false

    de-active-low:
      type: boolean
      required: false
      
    pixelclk-rising:
      type: boolean
      required: false

    pixelclk-falling:
      type: boolean
      required: false

    pixel-format:
      type: int
      enum:
        - 0
        - 1
        - 2
        - 3
        - 4
      required: false
```
